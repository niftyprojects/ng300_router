## Config.in
```kconfig
source "$BR2_EXTERNAL_NIFTY_ROUTER_PATH/packages/skeleton-ro-root/Config.in"
source "$BR2_EXTERNAL_NIFTY_ROUTER_PATH/packages/shorewall-core/Config.in"
source "$BR2_EXTERNAL_NIFTY_ROUTER_PATH/packages/shorewall/Config.in"
source "$BR2_EXTERNAL_NIFTY_ROUTER_PATH/packages/shorewall6/Config.in"
```

## configs/nifty_ng300_defconfig
```kconfig
BR2_x86_64=y
BR2_x86_atom=y
BR2_OPTIMIZE_3=y
BR2_TOOLCHAIN_BUILDROOT_WCHAR=y
# BR2_UCLIBC_INSTALL_UTILS is not set
BR2_TOOLCHAIN_BUILDROOT_CXX=y
BR2_GCC_ENABLE_LTO=y
BR2_GCC_ENABLE_GRAPHITE=y
BR2_ROOTFS_SKELETON_READONLY=y
BR2_ROOTFS_DEVICE_CREATION_DYNAMIC_MDEV=y
BR2_LINUX_KERNEL=y
BR2_LINUX_KERNEL_USE_CUSTOM_CONFIG=y
BR2_LINUX_KERNEL_CUSTOM_CONFIG_FILE="$(BR2_EXTERNAL_NIFTY_ROUTER_PATH)/board/kerio_ng300/linux.config"
BR2_PACKAGE_BUSYBOX_CONFIG="$(BR2_EXTERNAL_NIFTY_ROUTER_PATH)/board/kerio_ng300/busybox.config"
BR2_PACKAGE_BUSYBOX_SHOW_OTHERS=y
BR2_PACKAGE_HWDATA_IAB_OUI_TXT=y
BR2_PACKAGE_HWDATA_PNP_IDS=y
BR2_PACKAGE_LM_SENSORS=y
BR2_PACKAGE_LSHW=y
BR2_PACKAGE_PCIUTILS=y
BR2_PACKAGE_SKALIBS=y
BR2_PACKAGE_BRIDGE_UTILS=y
BR2_PACKAGE_DHCPCD=y
BR2_PACKAGE_DNSMASQ=y
# BR2_PACKAGE_DNSMASQ_TFTP is not set
BR2_PACKAGE_DNSMASQ_CONNTRACK=y
BR2_PACKAGE_DROPBEAR=y
BR2_PACKAGE_IFUPDOWN=y
BR2_PACKAGE_IFUPDOWN_SCRIPTS=y
BR2_PACKAGE_IPROUTE2=y
BR2_PACKAGE_IPTABLES=y
BR2_PACKAGE_IPUTILS=y
BR2_PACKAGE_MII_DIAG=y
BR2_PACKAGE_TCPDUMP=y
BR2_PACKAGE_LOGROTATE=y
BR2_PACKAGE_SUDO=y
BR2_PACKAGE_KMOD=y
BR2_PACKAGE_KMOD_TOOLS=y
BR2_PACKAGE_UTIL_LINUX=y
BR2_PACKAGE_UTIL_LINUX_LOGGER=y
BR2_PACKAGE_VIM=y
BR2_TARGET_GRUB2=y
BR2_PACKAGE_HOST_MKPASSWD=y
```

## packages/shorewall-core/Config.in
```kconfig
config BR2_PACKAGE_SHOREWALL_CORE
	bool "shorewall-core"
	select BR2_PACKAGE_PERL
	help
	  The Shoreline Firewall, more commonly known as “Shorewall”, is 
	  high-level tool for configuring Netfilter. You describe your 
	  firewall/gateway requirements using entries in a set of configuration
	  files. Shorewall reads those configuration files and with the help of
	  the iptables, iptables-restore, ip and tc utilities, Shorewall 
	  configures Netfilter and the Linux networking subsystem to match your
	  requirements. Shorewall can be used on a dedicated firewall system, a
	  multi-function gateway/router/server or on a standalone GNU/Linux
	  system.

	  https://shorewall.org
```

## packages/shorewall/Config.in
```kconfig
config BR2_PACKAGE_SHOREWALL
	bool "shorewall"
	select BR2_PACKAGE_SHOREWALL_CORE
	help
	  Provides IPv4 filtering functionality for Shorewall.

	  https://shorewall.org
```

## packages/shorewall6/Config.in
```kconfig
config BR2_PACKAGE_SHOREWALL6
	bool "shorewall6"
	select BR2_PACKAGE_SHOREWALL_CORE
	help
	  Provides IPv6 filtering functionality for Shorewall.

	  https://shorewall.org
```

## packages/skeleton-ro-root/Config.in
```kconfig
config BR2_PACKAGE_SKELETON_RO_ROOT
	bool 
	select BR2_PACKAGE_HAS_SKELETON

config BR2_PACKAGE_PROVIDES_SKELETON
	default "skeleton-ro-root" if BR2_PACKAGE_SKELETON_RO_ROOT
```
